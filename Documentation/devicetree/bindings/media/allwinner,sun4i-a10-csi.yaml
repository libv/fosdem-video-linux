## Documentation/devicetree/bindings/media/allwinner,sun4i-a10-csi.yaml
```yaml
# SPDX-License-Identifier: (GPL-2.0 OR BSD-2-Clause)
%YAML 1.2
---
$id: http://devicetree.org/schemas/arm/allwinner,sun4i-a10-csi.yaml#
$schema: http://devicetree.org/meta-schemas/core.yaml#

title: Allwinner A10 CMOS Sensor Interface (CSI) Device Tree Bindings

maintainers:
  - Chen-Yu Tsai <wens@csie.org>
  - Maxime Ripard <maxime.ripard@bootlin.com>

description: |-
  The Allwinner A10 and later has a CMOS Sensor Interface to retrieve
  frames from a parallel or BT656 sensor.


properties:
  compatible:
    oneOf:
      - items:
          - enum:
              - allwinner,sun7i-a20-csi0
          - const: allwinner,sun4i-a10-csi0

      - items:
          - const: allwinner,sun4i-a10-csi0

  reg:
    maxItems: 1

  interrupts:
    maxItems: 1

  clocks:
    items:
      - description: The CSI interface clock
      - description: The CSI module clock
      - description: The CSI ISP clock
      - description: The CSI DRAM clock

  clock-names:
    items:
      - const: bus
      - const: mod
      - const: isp
      - const: ram

  resets:
    description: The reset line driver this IP
    maxItems: 1

  pinctrl-0:
    minItems: 1

  pinctrl-names:
    const: default

  port:
    type: object
    additionalProperties: false

    properties:
      endpoint:
        properties:
          bus-width:
            const: 8
            description: Number of data lines actively used.

          data-active: true
          hsync-active: true
          pclk-sample: true
          remote-endpoint: true
          vsync-active: true

        required:
          - bus-width
          - data-active
          - hsync-active
          - pclk-sample
          - remote-endpoint
          - vsync-active

    required:
      - endpoint

required:
  - compatible
  - reg
  - interrupts
  - clocks

additionalProperties: false
...
```
